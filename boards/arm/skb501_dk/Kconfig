## boards/arm/skb501_dk/Kconfig
```kconfig
# Kconfig - skb501_dk board configuration
#
# Copyright (c) 2016 Nordic Semiconductor ASA
#
# SPDX-License-Identifier: Apache-2.0

if BOARD_SKB501_DK

config BOARD_ENABLE_DCDC
        bool "Enable DCDC mode"
        select SOC_DCDC_NRF52X
        default y

endif # BOARD_SKB501_DK
```

## boards/arm/skb501_dk/Kconfig.board
```kconfig
# Kconfig - skb501_dk board configuration
#
# Copyright (c) 2016 Nordic Semiconductor ASA
#
# SPDX-License-Identifier: Apache-2.0

config  BOARD_SKB501_DK
	bool "SKB501_DK"
	depends on SOC_NRF52840_QIAA
```

## boards/arm/skb501_dk/Kconfig.defconfig
```kconfig
# Kconfig - skb501_dk board configuration
#
# Copyright (c) 2016 Nordic Semiconductor ASA
#
# SPDX-License-Identifier: Apache-2.0

if BOARD_SKB501_DK

config BOARD
	default "skb501_dk"

if UART_NRFX

config UART_0_NRF_TX_PIN
	default 6

config UART_0_NRF_RX_PIN
	default 8

config UART_0_NRF_RTS_PIN
	default 5

config UART_0_NRF_CTS_PIN
	default 7

endif # UART_NRFX

if IEEE802154

config IEEE802154_NRF5
	default y

endif # IEEE802154

endif # BOARD_SKB501_DK
```

## drivers/counter/Kconfig.pcf8523_rtc
```kconfig
# Copyright (c) 2021 Endian Technologies AB
#
# SPDX-License-Identifier: Apache-2.0
#

config COUNTER_PCF8523_RTC
	bool "NXP PCF8523 RTC driver"
	select I2C
	depends on MINIMAL_LIBC
	help
	  Enable the counter driver for PCF8523 RTC I2C devices.

config COUNTER_PCF8523_INIT_PRIORITY
	int "Init priority"
	depends on COUNTER_PCF8523_RTC
	default 65
	help
	  PCF8523 device driver initialization priority.
```

## drivers/modem/Kconfig.gsm
```kconfig
# Copyright (c) 2020 Intel Corporation
# SPDX-License-Identifier: Apache-2.0

config MODEM_GSM_PPP
	bool "Support GSM modems"
	select MODEM_CONTEXT
	select MODEM_CMD_HANDLER
	select MODEM_IFACE_UART
	help
	  Enable GSM modems that support standard AT commands and PPP.

if MODEM_GSM_PPP

config MODEM_GSM_UART_NAME
	string "UART device name the modem is connected to"

config MODEM_GSM_INIT_PRIORITY
	int "Init priority for the GSM modem driver"
	default 42
	range 0 99
	help
	  The GSM modem is initialized in POST_KERNEL using priority in
	  the range 0-99.

config MODEM_GSM_APN
	string "Access Point Name"
	default "internet"
	help
	  Specify Access Point Name, i.e. the name to identify Internet IP
	  GPRS cellular data context.

config MODEM_GSM_MANUAL_MCCMNO
	string "MCC/MNO for establishing network connection"
	help
	  This setting is used in the AT+COPS command to set the MCC/MNO
	  for the network connection context.  This value is specific to
	  the network provider and may need to be changed if auto is not
	  selected.

config MODEM_GSM_MNOPROF
	int "MNO profile for the network connection"
	default 100
	help
	  This setting is used in the AT+UMNOPROF command to set the MNO
	  profile for the network connection.  This value is specific to
	  the network provider and must be changed.

config MODEM_GSM_NET_STATUS
	bool "Enable support for network status indication"
	help
	  Choose this setting to use a modem GPIO pin as network indication.

if MODEM_GSM_NET_STATUS

config MODEM_GSM_NET_STATUS_PIN
	int "Network status indication GPIO ID"
	default 16
	help
	  This setting is used to configure one of the modem's GPIO pins
	  as a network status indication.  See the manual for the gpio ids
	  and how they map to pin numbers. Only works with U-blox modems.
	  This is not meant to be upstreamed!

endif # MODEM_GSM_NET_STATUS

endif
```

## drivers/modem/Kconfig.gsm_endian
```kconfig
# © 2020 Endian Technologies AB
#
# SPDX-License-Identifier: Apache-2.0

config MODEM_GSM_MNOPROF
       int "MNO profile for the network connection"
       default 100
       help
         This setting is used in the AT+UMNOPROF command to set the MNO
         profile for the network connection.  This value is specific to
         the network provider and must be changed.

config MODEM_GSM_NET_STATUS
       bool "Enable support for network status indication"
       help
         Choose this setting to use a modem GPIO pin as network indication.

if MODEM_GSM_NET_STATUS

config MODEM_GSM_NET_STATUS_PIN
       int "Network status indication GPIO ID"
       default 16
       help
         This setting is used to configure one of the modem's GPIO pins
         as a network status indication.  See the manual for the gpio ids
         and how they map to pin numbers. Only works with U-blox modems.
         This is not meant to be upstreamed!

endif # MODEM_GSM_NET_STATUS

config MODEM_GSM_CONFIGURE_URAT
       bool "Enable support for selecting RATs"
       help
         Choose this setting to select the Radio Access Technologies used.

if MODEM_GSM_CONFIGURE_URAT

config MODEM_GSM_URAT
       string "Radio Access Technologies (RATs)"
       default "7,8,9"
       help
         This setting is used to change the RATs that the modem will use
         to connect to the network
         This is not meant to be upstreamed as-is!

endif # MODEM_GSM_CONFIGURE_URAT

config MODEM_GSM_CONFIGURE_UBANDMASK
       bool "Enable support for selecting band masks"
       help
         Choose this setting to select the band masks for each RAT.

if MODEM_GSM_CONFIGURE_UBANDMASK

config MODEM_GSM_UBANDMASK_M1
       int "Bandmask for LTE-M1"
       default 526494
       help
         This setting is used to change the band mask for LTE-M1. It
         is a bitmask where bit 0 is band 1, etc.
         This is not meant to be upstreamed as-is!

config MODEM_GSM_UBANDMASK_NB1
       int "Bandmask for LTE-NB1"
       default 526494
       help
         This setting is used to change the band mask for LTE-NB1. It
         is a bitmask where bit 0 is band 1, etc.
         This is not meant to be upstreamed as-is!

endif # MODEM_GSM_CONFIGURE_UBANDMASK
```

## dts/bindings/display/solomon,ssd16xx.yaml
```yaml
# Copyright (c) 2018, Phytec Messtechnik GmbH
# Copyright (c) 2020 Endian Technologies AB
# SPDX-License-Identifier: Apache-2.0

description: SSD16XX 250x150 EPD display controller

compatible: "solomon,ssd16xxfb"

include: spi-device.yaml

properties:
    height:
      type: int
      required: true
      description: Height in pixel of the panel driven by the controller

    width:
      type: int
      required: true
      description: Width in pixel of the panel driven by the controller

    pp-height-bits:
      type: int
      required: true
      description: Number of bits used for the height parameters

    pp-width-bits:
      type: int
      required: true
      description: Number of bits used for the width parameters

    orientation-flipped:
      type: boolean
      required: false
      description: Last column address is mapped to first segment

    power-gpios:
      type: phandle-array
      required: false
      description: Power enable pin.

        This pin will be set to its active level to enable power to
        the display.

    reset-gpios:
      type: phandle-array
      required: true
      description: RESET pin.

        The RESET pin of SSD16XX is active low.
        If connected directly the MCU pin should be configured
        as active low.

    dc-gpios:
      type: phandle-array
      required: true
      description: DC pin.

        The DC pin of SSD16XX is active low (transmission command byte).
        If connected directly the MCU pin should be configured
        as active low.

    busy-gpios:
      type: phandle-array
      required: true
      description: BUSY pin.

        The BUSY pin of SSD16XX is active high.
        If connected directly the MCU pin should be configured
        as active high.

    tssv:
      type: int
      required: false
      description: Temperature Sensor Selection Value

        Display controller can have integrated temperature sensor or
        an external temperature sensor is connected to the controller.
        The value selects which sensor should be used.

    # Values for a full refresh. A full refresh means that the display
    # will flash repeatedly before rendering the image.

    gdv:
      type: uint8-array
      required: true
      description: Gate driving voltage values (full refresh)

    sdv:
      type: uint8-array
      required: true
      description: Source driving voltage values (full refresh)

    vcom:
      type: int
      required: false
      description: VCOM voltage (full refresh)

    dummy-line-period:
      type: int
      required: false
      description: Dummy line period (full refresh)

    gate-line-width:
      type: int
      required: false
      description: Gate line width (full refresh)

    border-waveform:
      type: int
      required: true
      description: Border waveform (full refresh)

    softstart:
      type: uint8-array
      required: false
      description: Booster soft start values

    lut-initial:
      type: uint8-array
      required: false
      description: LUT (full refresh)

    # Values for a partial refresh. A partial refresh is done without
    # flashing the screen, but there may be some shadowing from old
    # pixel values.

    vcom-default:
      type: int
      required: false
      description: VCOM voltage (full refresh)

    lut-default:
      type: uint8-array
      required: false
      description: LUT (partial refresh)

    otp-selection-default:
      type: uint8-array
      required: false
      description: OTP selection (partial refresh)

    border-waveform-default:
      type: int
      required: false
      description: Border waveform (partial refresh)
```

## dts/bindings/rtc/nxp,pcf8523.yaml
```yaml
#
# Copyright (c) 2021 Endian Technologies AB
#
# SPDX-License-Identifier: Apache-2.0
#

description: NXP PCF8523 RTC binding

compatible: "nxp,pcf8523"

include: i2c-device.yaml

properties:
    reg:
      required: true

    pf:
      type: int
      required: false
      description: |
        Internal oscillator capacitance for quart crystals with a
        corresponding load capacitance. Use 0 to select 7 pF or 1 to
        select 12.5 pF. The hardware default is 7 pF.

    pm:
      type: int
      required: false
      description: |
        Power management control, a value between 0 and 7 (inclusive).
        This controls the battery-switchover and battery low
        functions. See the data sheet. The hardware default is seven.
```
